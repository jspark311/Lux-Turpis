## sdkconfig.defaults
```kconfig
CONFIG_IDF_TARGET="esp32"

#
# Ethernet interface Configuration
#
CONFIG_PHY_LAN8720=y
CONFIG_PHY_ADDRESS=0
CONFIG_PHY_USE_POWER_PIN=
CONFIG_PHY_SMI_MDC_PIN=23
CONFIG_PHY_SMI_MDIO_PIN=18
```
